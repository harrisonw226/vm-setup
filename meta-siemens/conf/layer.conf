## meta-siemens/conf/layer.conf
```bitbake
# We have a conf and classes directory, add to BBPATH
BBPATH .= ":${LAYERDIR}"

# We have recipes-* directories, add to BBFILES
BBFILES += "${LAYERDIR}/recipes-*/*/*.bb \
            ${LAYERDIR}/recipes-*/*/*.bbappend"

BBFILE_COLLECTIONS += "meta-siemens"
BBFILE_PATTERN_meta-siemens = "^${LAYERDIR}/"
BBFILE_PRIORITY_meta-siemens = "6"

LAYERDEPENDS_meta-rti = "core"
LAYERSERIES_COMPAT_meta-rti = "kirkstone"
```

## meta-siemens/files/conf/bblayers.conf
```bitbake
# POKY_BBLAYERS_CONF_VERSION is increased each time build/conf/bblayers.conf
# changes incompatibly
POKY_BBLAYERS_CONF_VERSION = "2"

BBPATH = "${TOPDIR}"
BBFILES ?= ""

BBLAYERS ?= " \
  /home/developer/siemens-build/sources/poky/meta \
  /home/developer/siemens-build/sources/poky/meta-poky \
  /home/developer/siemens-build/sources/poky/meta-yocto-bsp \
  /home/developer/siemens-build/sources/meta-openembedded/meta-oe \
  /home/developer/siemens-build/sources/meta-openembedded/meta-python \
  /home/developer/siemens-build/sources/meta-openembedded/meta-networking \
  /home/developer/siemens-build/sources/meta-openembedded/meta-webserver \
  /home/developer/siemens-build/sources/meta-qt5 \
  /home/developer/siemens-build/sources/meta-swupdate \
  /home/developer/siemens-build/sources/meta-freescale \
  /home/developer/siemens-build/sources/meta-fsl-demos \
  /home/developer/siemens-build/sources/meta-timesys \
  /home/developer/siemens-build/sources/meta-digi/meta-digi-arm \
  /home/developer/siemens-build/sources/meta-digi/meta-digi-dey \
  /home/developer/siemens-build/sources/meta-digi/meta-siemens \
  "
```
